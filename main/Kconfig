## main/Kconfig
```kconfig
menu "BLE Characteristics"
config BLE_CHARS
   int "number of BLE characteristics to allocate"
   default 200
   help
	  Number of BLE characteristics to allocate
endmenu
```
